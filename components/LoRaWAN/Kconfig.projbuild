## components/LoRaWAN/Kconfig.projbuild
```kconfig
menu "LoRaWAN"
    menu "Enable built-in REGION"
        config REGION_EU868
            bool "Enable EU868"
            default y
        config REGION_US915
            bool "Enable US915"
            default y
        config REGION_CN779
            bool "Enable CN779"
            default y
        config REGION_EU433
            bool "Enable EU433"
            default y
        config REGION_AU915
            bool "Enable AU915"
            default y
        config REGION_AS923
            bool "Enable AS923"
            default y
        config REGION_CN470
            bool "Enable CN470"
            default y
        config REGION_KR920
            bool "Enable KR920"
            default y
        config REGION_IN865
            bool "Enable IN865"
            default y
        config REGION_RU864
            bool "Enable RU864"
            default y

        choice CHANNEL_PLAN_GROUP_AS923_DEFAULT
            depends on REGION_AS923
            prompt "Default channel plan for AS923"
            default CHANNEL_PLAN_GROUP_AS923_1
        config CHANNEL_PLAN_GROUP_AS923_1
            bool "CHANNEL_PLAN_GROUP_AS923_1"
        config CHANNEL_PLAN_GROUP_AS923_2
            bool "CHANNEL_PLAN_GROUP_AS923_2"
        config CHANNEL_PLAN_GROUP_AS923_3
            bool "CHANNEL_PLAN_GROUP_AS923_3"
        config CHANNEL_PLAN_GROUP_AS923_4
            bool "CHANNEL_PLAN_GROUP_AS923_4"
        config CHANNEL_PLAN_GROUP_AS923_1_JP_CH24_CH38_LBT
            bool "CHANNEL_PLAN_GROUP_AS923_1_JP_CH24_CH38_LBT"
        config CHANNEL_PLAN_GROUP_AS923_1_JP_CH24_CH38_DC
            bool "CHANNEL_PLAN_GROUP_AS923_1_JP_CH24_CH38_DC"
        config CHANNEL_PLAN_GROUP_AS923_1_JP_CH37_CH61_LBT_DC
            bool "CHANNEL_PLAN_GROUP_AS923_1_JP_CH37_CH61_LBT_DC"
        endchoice

        choice CHANNEL_PLAN_GROUP_CN470_DEFAULT
            depends on REGION_CN470
            prompt "Default channel plan for CN470"
            default CHANNEL_PLAN_20MHZ_TYPE_A
        config CHANNEL_PLAN_20MHZ_TYPE_A
            bool "CHANNEL_PLAN_20MHZ_TYPE_A"
        config CHANNEL_PLAN_20MHZ_TYPE_B
            bool "CHANNEL_PLAN_20MHZ_TYPE_B"
        config CHANNEL_PLAN_26MHZ_TYPE_A
            bool "CHANNEL_PLAN_26MHZ_TYPE_A"
        config CHANNEL_PLAN_26MHZ_TYPE_B
            bool "CHANNEL_PLAN_26MHZ_TYPE_B"
        endchoice
    endmenu

    config USE_LRWAN_1_1_X_CRYPTO
        bool "USE LRWAN_1_1_X_CRYPTO"
        default n
endmenu
```

## components/bsp/Kconfig.projbuild
```kconfig
menu "Board Configuration"

    choice LCD_BOARD
        prompt "Select LCD Board"
        default LCD_BOARD_SENSECAP_INDICATOR_D1
    config LCD_BOARD_EV
        bool "ESP32-S3-LCD-EV-BOARD Development Board"
    config LCD_BOARD_SENSECAP_INDICATOR_WXM
        bool "SenseCAP Indicator for WXM"
    config LCD_BOARD_SENSECAP_INDICATOR_D1
        bool "SenseCAP Indicator D1/D1S"
    config LCD_BOARD_SENSECAP_INDICATOR_D1L
        bool "SenseCAP Indicator D1L/D1Pro ( with Lora)"
    endchoice

    choice LCD_SUB_BOARD
        depends on LCD_BOARD_EV
        prompt "Select LCD Sub Board"
        default LCD_EV_SUB_BOARD2
        help
            Select an sub board for LCD EV mainboard
    config LCD_EV_SUB_BOARD1
        bool "SUB_BOARD1 128x64 & 320x240 screen"
    config LCD_EV_SUB_BOARD2
        bool "SUB_BOARD2 480x480 & 320x480 screen"
    config LCD_EV_SUB_BOARD3
        bool "SUB_BOARD3 800x480 screen"
    config LCD_EV_SUB_BOARD
        bool "SUB_BOARD3 800x480 screen"
    endchoice

    choice LCD_SUB_BOARD1_SCREEN
        depends on LCD_EV_SUB_BOARD1
        prompt "Select screen for Sub Board1"
        default LCD_EV_SUB_BOARD1_LCD_320x240
    config LCD_EV_SUB_BOARD1_OLED_128x64
        bool "128x64 0.96' OLED screen"
    config LCD_EV_SUB_BOARD1_LCD_320x240
        bool "320x240 2.4' LCD screen"
    endchoice

    choice LCD_SUB_BOARD2_SCREEN
        depends on LCD_EV_SUB_BOARD2
        prompt "Select screen for Sub Board2"
        default LCD_EV_SUB_BOARD2_LCD_480x480
    config LCD_EV_SUB_BOARD2_LCD_480x480
        bool "480x480 3.95' LCD screen"
    config LCD_EV_SUB_BOARD2_LCD_480x320
        bool "480x320 3.5' LCD screen"
    endchoice

    choice LCD_SUB_BOARD2_SCREEN_DATA_WIDTH
        depends on LCD_EV_SUB_BOARD2_LCD_480x320
        prompt "Select data width for 480x320 3.5' LCD screen"
        default LCD_EV_SUB_BOARD2_LCD_480x320_8BIT
    config LCD_EV_SUB_BOARD2_LCD_480x320_8BIT
        bool "8Bit 8080 interface"
    config LCD_EV_SUB_BOARD2_LCD_480x320_16BIT
        bool "16Bit 8080 interface"
    endchoice

    choice SENSECAP_INDICATOR_SCREEN
        depends on LCD_BOARD_SENSECAP_INDICATOR_WXM || LCD_BOARD_SENSECAP_INDICATOR_D1 || LCD_BOARD_SENSECAP_INDICATOR_D1L
        prompt "Select the screen type for SenseCAP Indicator boards"
        default SENSECAP_INDICATOR_SCREEN_GX
    config SENSECAP_INDICATOR_SCREEN_GX
        bool "GuanXian 4.0 inch RGB (SPI+RGB)"
    config SENSECAP_INDICATOR_SCREEN_DX
        bool "DaXian 4.0 inch RGB (RGB only)"
    endchoice

    config LCD_EVB_SCREEN_WIDTH
        int
        default 800 if LCD_EV_SUB_BOARD3
        default 480 if LCD_EV_SUB_BOARD2_LCD_480x480 || SENSECAP_INDICATOR_SCREEN_GX || SENSECAP_INDICATOR_SCREEN_DX
        default 320 if LCD_EV_SUB_BOARD2_LCD_480x320
        default 240 if LCD_EV_SUB_BOARD1_LCD_320x240
        default 128 if LCD_EV_SUB_BOARD1_OLED_128x64

    config LCD_EVB_SCREEN_HEIGHT
        int
        default 480 if LCD_EV_SUB_BOARD3 || LCD_EV_SUB_BOARD2_LCD_480x480 || LCD_EV_SUB_BOARD2_LCD_480x320 || SENSECAP_INDICATOR_SCREEN_GX || SENSECAP_INDICATOR_SCREEN_DX
        default 320 if LCD_EV_SUB_BOARD1_LCD_320x240
        default 64 if LCD_EV_SUB_BOARD1_OLED_128x64

    choice LCD_EVB_SCREEN_ROTATION
        prompt "Set rotation of lcd and touch"
        default LCD_EVB_SCREEN_ROTATION_0
        config LCD_EVB_SCREEN_ROTATION_0
            bool "Rotate 0"
        config LCD_EVB_SCREEN_ROTATION_90
            bool "Rotate 90"
        config LCD_EVB_SCREEN_ROTATION_180
            bool "Rotate 180"
        config LCD_EVB_SCREEN_ROTATION_270
            bool "Rotate 270"
    endchoice

    config LCD_EVB_SCREEN_FREQ
        depends on LCD_EV_SUB_BOARD2_LCD_480x480 || LCD_EV_SUB_BOARD3 || SENSECAP_INDICATOR_SCREEN_GX || SENSECAP_INDICATOR_SCREEN_DX
        int "Frequency of lcd pclk"
        default 18

    config LCD_AVOID_TEAR
        depends on LCD_EV_SUB_BOARD2_LCD_480x480 || LCD_EV_SUB_BOARD3 || SENSECAP_INDICATOR_SCREEN_GX || SENSECAP_INDICATOR_SCREEN_DX
        depends on LCD_EVB_SCREEN_ROTATION_0
        bool "Avoid tearing effect"
        default "n"

    choice LCD_LVGL_MODE
        depends on LCD_AVOID_TEAR
        prompt "Select lvgl mode for avoiding tearing"
        default LCD_LVGL_FULL_REFRESH
        config LCD_LVGL_FULL_REFRESH
            bool "full refresh with two frame psram buffer"
        config LCD_LVGL_DIRECT_MODE
            bool "direct mode with two frame psram buffer"
    endchoice

    config LCD_TASK_PRIORITY
        depends on LCD_AVOID_TEAR
        int "Priority of lcd refresh task"
        default 5

    config LCD_TASK_REFRESH_TIME
        depends on LCD_AVOID_TEAR
        int "Screen refresh period(ms)"
        default 40
endmenu
```

## components/liblorahub/Kconfig.projbuild
```kconfig
menu "LoRaWAN 1-CH HUB Configuration"
        
menu "Hardware Configuration"
    
    choice GATEWAY_HW_BOARD
        prompt "Board type"
        default HELTEC_WIFI_LORA_32_V3
        help
            Select the hardware board on which the LoRaHub is run (Semtech DevKit, Heltec WiFi LoRa 32 v3, ...).
        config SEMTECH_DEVKIT
            bool "Semtech DevKit"
            help
                Select Semtech DevKit.
        config HELTEC_WIFI_LORA_32_V3
            bool "Heltec WiFi LoRa 32 v3"
            help
                Select Heltec WiFi LoRa 32 v3.
    endchoice

	choice RADIO_TYPE
		prompt "LoRa radio type"
		default RADIO_TYPE_SX1262 if HELTEC_WIFI_LORA_32_V3
		help
			Select the radio type used by the LoRaHub (sx1261, sx1262, sx1268, llcc68, lr1121).

		config RADIO_TYPE_SX1261
			bool "sx1261"
			help
				Select sx1261 radio.

		config RADIO_TYPE_SX1262
			bool "sx1262"
			help
				Select sx1262 radio.

		config RADIO_TYPE_SX1268
			bool "sx1268"
			help
				Select sx1268 radio.

		config RADIO_TYPE_LLCC68
			bool "llcc68"
			help
				Select llcc68 radio.

		config RADIO_TYPE_LR1121
			bool "lr1121"
			help
				Select lr1121 radio.
	endchoice

    config GATEWAY_DISPLAY
        bool "OLED Display"
        default y
        help
            Is there an OLED display connected ?

endmenu # Hardware Configuration

menu "Packet Forwarder Configuration"

    config GATEWAY_ID_AUTO
        bool "Gateway_ID AUTO"
        default y
        help
            Gateway ID automatically set based on MAC address.

    if !GATEWAY_ID_AUTO
        config GATEWAY_ID_CUSTOM
            string "User defined Gateway ID"
            help
                Set Gateway ID. Hex string, 8 bytes.
    endif # GATEWAY_ID_AUTO

    config GET_CFG_FROM_FLASH
        bool "Get config from flash in priority"
        default y
        help
            Get gateway configuration from NVS flash for existing fields.

    config CHANNEL_FREQ_HZ
        int "Channel frequency in Hertz"
        default 868100000
        range 400000000 1000000000
        help
            Set frequency to use[Hz].

    config CHANNEL_LORA_DATARATE
        int "Channel LoRa datarate (SF)"
        default 7
        range 5 12
        help
            Set LoRa channel datarate (SF).

    config CHANNEL_LORA_BANDWIDTH
        int "Channel LoRa bandwidth in kHz"
        default 125
        range 125 500
        help
            Set LoRa channel bandwidth (125, 250, 500) kHz.

    config NETWORK_SERVER_ADDRESS
        string "LoRaWAN network server URL or IP address"
        default "eu1.cloud.thethings.network"
        help
            Set the LoRaWAN network server address URL or IP.

    config NETWORK_SERVER_PORT
        int "LoRaWAN network server port"
        default 1700
        help
            Set the LoRaWAN network server port.

    config SNTP_SERVER_ADDRESS
        string "URL or IP address of the SNTP server"
        default "pool.ntp.org"
        help
            Set the SNTP server address URL or IP.

    config WIFI_PROV_DELAY_S
        int  "WiFi provisioning delay (s)"
        default 5
        range 0 255
        help
            Waiting period for the user to activate WiFi provisioning mode (in seconds).

endmenu # Packet Forwarder Configuration

endmenu # LoRa 1-CH HUB Configuration
```
